//wenjie.liu add for: pn557 nfc dtsi 2021-09-018
//#include "nfc/panther-nfc-pn557.dtsi"

&soc {
	//add for creating a shared memory with uio for nv backup and restore
	qcom, oembackup_sharedmem@0 {
		compatible = "qcom,sharedmem-uio";
		reg = <0x0 0x00100000>;
		reg - names = "oembackup";
		qcom, client - id = <0x00000004>;
		qcom, guard - memory;
		qcom, vm - nav - path;
	};
};
